#include "stm8s.h"
#include "stdio.h"
#include "stdint.h"
#include "mylibrary.h"

#define OLED_I2C_ADDR	0x78
#define OLED_CMD_MODE   0x00	// set command mode
#define OLED_DAT_MODE   0x40    // set data mode

const uint8_t OLED_INIT_CMD[] = {
	0xA8, 0x1F,       // set multiplex (HEIGHT-1): 0x1F for 128x32, 0x3F for 128x64
	0x22, 0x00, 0x03, // set min and max page
	0x20, 0x00,       // set horizontal memory addressing mode
	0xDA, 0x02,       // set COM pins hardware configuration to sequential
	0x8D, 0x14,       // enable charge pump
	0xAF,             // switch on OLED
	0xA1, 0xC8        // flip the screen
};
// standard ASCII 5x8 font (adapted from Neven Boyanov and Stephen Denne)
const uint8_t OLED_FONT[]= {
	0x00, 0x00, 0x00, 0x00, 0x00, //   0
	0x00, 0x00, 0x2f, 0x00, 0x00, // ! 1
	0x00, 0x07, 0x00, 0x07, 0x00, // " 2
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	0x40, 0x40, 0x40, 0x40, 0x40  // _ 63
};
void OLED_init(void);
void OLED_printP(const char *p);
void OLED_printNum(uint16_t num);
void OLED_printFloat(float num);
void OLED_cursor(uint8_t xpos, uint8_t ypos);
void OLED_clear(void);
/*==========================================================
-----------------MAIN FUNCTION------------
=============================================================*/
const char a[] = "HELLO";
void main(void) {
	CLK_HSIConfig();

	// LED_PORT->ODR = GPIO_ODR_RESET_VALUE; /* Reset Output Data Register */
    // LED_PORT->DDR = GPIO_DDR_RESET_VALUE; /* Reset Data Direction Register */
    // LED_PORT->CR1 = GPIO_CR1_RESET_VALUE; /* Reset Control Register 1 */
    // LED_PORT->CR2 = GPIO_CR2_RESET_VALUE; /* Reset Control Register 2 */

    // LED_PORT->DDR |= (uint8_t)LED_PIN; /* Set Output mode */
    // LED_PORT->ODR &= (uint8_t)(~LED_PIN); /* Low level */
    // LED_PORT->CR1 |= (uint8_t)LED_PIN; /* Pull-Up or Push-Pull */
    // LED_PORT->CR2 |= (uint8_t)LED_PIN; /* Interrupt or Slow slope */

	I2C_init();
	OLED_init();
	OLED_clear();
	OLED_cursor(0,0);
	OLED_printP(a);
	while(1) {
    }
}

void OLED_init(void) {
	I2C_start();
	I2C_address(OLED_I2C_ADDR, I2C_DIRECTION_TX);
	I2C_write(OLED_CMD_MODE);
	for (uint8_t i = 0;i < 12;i++)
	{
		I2C_write(OLED_INIT_CMD[i]);
	}
	I2C_stop();
}
void OLED_printP(const char *p)
{
	I2C_start();
	I2C_address(OLED_I2C_ADDR,I2C_DIRECTION_TX);
	I2C_write(OLED_DAT_MODE);
	while (*p)
	{
		uint16_t offset = *p - 32;
		offset += offset << 2;
		I2C_write(0x00);
		for(uint8_t i = 5; i;i--){ I2C_write(OLED_FONT[offset++]); }
		p++;
	}
	I2C_stop();
	
}
void OLED_printNum(uint16_t num){
	uint8_t mang[] = {0,0,0,0,0};
	uint8_t count = 0;
	while(num != 0){
		mang[count] = num%10;
		num = num /10;
		++count;
	}
	I2C_start();
	I2C_address(OLED_I2C_ADDR,I2C_DIRECTION_TX);
	I2C_write(OLED_DAT_MODE);
	while(count != 0){
		uint16_t offset = mang[count-1] + 16;
		offset += offset << 2;
		I2C_write(0x00);
		for(uint8_t i = 5; i;i--){ I2C_write(OLED_FONT[offset++]); }
		--count;
	}
	I2C_stop();		
}
// 1.098;  10.98; 109.98;
// |		|		|
// 109.8	1098	10998

// mang[0]=9->num=10;->mang[1]=0->num=1;->mang[2]=.->mang[3]=1->num=0,count=4
void OLED_printFloat(float num){
	num = (float)num * 100;
	int8_t mang[] = {0,0,0,0,0};
	uint8_t count = 0;
	while(num != 0){
		mang[count] = num%10;
		num = num /10;
		++count;
		if(count==2) {mang[2]= -2; ++count;}
	}
	I2C_start();
	I2C_address(OLED_I2C_ADDR,I2C_DIRECTION_TX);
	I2C_write(OLED_DAT_MODE);
	while(count != 0){
		uint16_t offset = mang[count-1] + 16;
		offset += offset << 2;
		I2C_write(0x00);
		for(uint8_t i = 5; i;i--){ I2C_write(OLED_FONT[offset++]); }
		--count;
	}
	I2C_stop();		
}
void OLED_cursor(uint8_t xpos, uint8_t ypos)
{
	I2C_start();
	I2C_address(OLED_I2C_ADDR, I2C_DIRECTION_TX);
	I2C_write(OLED_CMD_MODE);
	I2C_write(xpos & 0x0F);
	I2C_write(0x10 | (xpos >> 4));
	I2C_write(0xB0 | (ypos & 0x07));
	I2C_stop();
}
void OLED_clear(void)
{
	OLED_cursor(0,0);
	I2C_start();
	I2C_address(OLED_I2C_ADDR, I2C_DIRECTION_TX);
	I2C_write(OLED_DAT_MODE);
	for (uint16_t i=0;i<512;i++)
	{
		I2C_write(0x00);
	}
	I2C_stop();
}